## zephyr/Kconfig
```kconfig
# Copyright (c) 2026 ITE Corporation. All Rights Reserved.
# SPDX-License-Identifier: Apache-2.0

config PSA_CRYPTO_DRIVER_ITE_IT51XXXX
	bool "Build psa_crypto_driver for ite it51xxx"
	depends on MBEDTLS_PSA_CRYPTO_C
	default n
	help
		Enables it51xxx support in psa-crypto-driver component
```
